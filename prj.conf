## CMakeLists.txt
```
cmake_minimum_required(VERSION 3.20.0)
set(DTC_OVERLAY_FILE "${CMAKE_CURRENT_SOURCE_DIR}/src/app.overlay")
find_package(Zephyr REQUIRED HINTS $ENV {ZEPHYR_BASE})
project (BME680_driver)

# Add your source files here
target_sources(app PRIVATE src/main.c src/bme680_driver.c)
```

## prj.conf
```kconfig
CONFIG_GPIO=y

CONFIG_I2C=y
CONFIG_SENSOR=y
CONFIG_BME680=y
CONFIG_CBPRINTF_FP_SUPPORT=y
```

## src/main.c
```c
#include <zephyr/kernel.h>
#include <zephyr/device.h>
#include <zephyr/drivers/gpio.h>
#include "bme680_driver.h"

int main(void)
{

/* Get the buzzer configuration from the devicetree alias */
static const struct gpio_dt_spec buzzer = GPIO_DT_SPEC_GET(DT_ALIAS(buzzer), gpios);

/* Define your threshold */
#define TEMP_THRESHOLD_CELSIUS 23

    /* 1. Initialize our wrapper struct using the devicetree label */
    struct bme680_app_device my_sensor = {
        .dev = DEVICE_DT_GET(DT_NODELABEL(bme680))
    };

    // prepare the Buzzer Hardware
if(!device_is_ready(buzzer.port)){
printk("Error: Buzzer device is not ready\n");
return 0;

}
gpio_pin_configure_dt(&buzzer, GPIO_OUTPUT_INACTIVE);

    /* 2. Initialize the sensor using our API wrapper function */
    if (app_bme680_init(&my_sensor) != 0) {
        printk("Failed to initialize BME680 via Sensor API\n");
        return 0;
    }

    printk("BME680 API Driver Started Successfully!\n");

    while (1) {
        /* 3. Fetch all data (Temp, Press, Hum) in one command */
        if (app_bme680_fetch_data(&my_sensor) == 0) {
            
            /* Print the human-readable values */
            /* val1 is the integer part, val2 is the micro-decimal part */
            printk("Temp: %d.%06d C | Press: %d.%06d kPa | Hum: %d.%06d %%\n",
                   my_sensor.temp.val1, my_sensor.temp.val2,
                   my_sensor.press.val1, my_sensor.press.val2,
                   my_sensor.hum.val1, my_sensor.hum.val2);

                   // print the reistance in ohms,high gas resistance means good air quality, low gas resistance means bad air quality

                   printk("gas resistance:%d ohms\n",my_sensor.gas.val1);
               
//BUZZER logic: if temp is above threshold, turn on buzzer, else turn off buzzer
if(my_sensor.temp.val1>= TEMP_THRESHOLD_CELSIUS){
    printk("!!warning: HIGH TEMPERATURE!!\n");

    for (int i=0;i<250;i++){
gpio_pin_set_dt(&buzzer, 1); // turn on buzzer
k_usleep(1000);
gpio_pin_set_dt(&buzzer, 0); // turn off buzzer
k_usleep(1000);

}

}else{
    gpio_pin_set_dt(&buzzer, 0); // turn off buzzer
}

        printk("--------------------------------------------------\n");
        } 

        /* Wait 3 seconds before the next reading */
        k_msleep(500);
    }
    
}
```

## src/bme680_driver.c
```c
#include "bme680_driver.h"          // This lets the .c see the struct definition
#include <zephyr/drivers/sensor.h>  // This lets the .c see sensor_sample_fetch
#include <zephyr/logging/log.h>

LOG_MODULE_REGISTER(bme680_driver, LOG_LEVEL_INF);

int app_bme680_init(struct bme680_app_device *app_dev)
{
    if (!device_is_ready(app_dev->dev)) {
        return -1;
    }
    return 0;
}

int app_bme680_fetch_data(struct bme680_app_device *app_dev)
{
    int ret = sensor_sample_fetch(app_dev->dev);
    if (ret < 0) return ret;

    sensor_channel_get(app_dev->dev, SENSOR_CHAN_AMBIENT_TEMP, &app_dev->temp);
    sensor_channel_get(app_dev->dev, SENSOR_CHAN_PRESS, &app_dev->press);
    sensor_channel_get(app_dev->dev, SENSOR_CHAN_HUMIDITY, &app_dev->hum);
    sensor_channel_get(app_dev->dev, SENSOR_CHAN_GAS_RES, &app_dev->gas);

    return 0;
}
```

## src/bme680_driver.h
```c
#ifndef BME680_DRIVER_H
#define BME680_DRIVER_H

#include <zephyr/device.h>
#include <zephyr/drivers/sensor.h>  

struct bme680_app_device {
    const struct device *dev;
    struct sensor_value temp;
    struct sensor_value press;
    struct sensor_value hum;
    struct sensor_value gas;
};

int app_bme680_init(struct bme680_app_device *app_dev);
int app_bme680_fetch_data(struct bme680_app_device *app_dev);

#endif
```
